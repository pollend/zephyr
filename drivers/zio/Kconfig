## drivers/zio/Kconfig
```kconfig
# Kconfig - zio configuration options

#
# Copyright (c) 2019 Thomas Burdick <thomas.burdick@gmail.com>
#
# SPDX-License-Identifier: Apache-2.0
#

menuconfig ZIO
	bool "ZIO Drivers"
	help
	  Include zio drivers in system config

if ZIO

module = ZIO
module-str = zio
source "subsys/logging/Kconfig.template.log_config"

comment "Device Drivers"

source "drivers/zio/synth/Kconfig"

endif # ZIO
```
